## meta-greenbase/conf/machine/gb-sbc.conf
```bitbake
require conf/machine/include/hailo15-base.inc
require conf/machine/include/hailo-vpu-base.inc

UBOOT_MACHINE = "gb_sbc_defconfig"
```

## meta-hailo-bsp/conf/machine/hailo10-m2.conf
```bitbake
MACHINEOVERRIDES =. "hailo10-m2:"

require include/hailo15-base.inc
require include/hailo-accelerator-base.inc

UBOOT_MACHINE = "hailo10_m2_defconfig"
```

## meta-hailo-bsp/conf/machine/hailo15-evb-2-camera-vpu.conf
```bitbake
require include/hailo15-evb.inc
require include/hailo-vpu-base.inc

UBOOT_MACHINE = "hailo15_evb_2_camera_vpu_defconfig"
```

## meta-hailo-bsp/conf/machine/hailo15-evb-security-camera.conf
```bitbake
require include/hailo15-evb.inc
require include/hailo-vpu-base.inc

UBOOT_MACHINE = "hailo15_evb_security_camera_defconfig"
```

## meta-hailo-bsp/conf/machine/hailo15l-evb.conf
```bitbake
require include/hailo15l-base.inc
require include/hailo-vpu-base.inc

UBOOT_MACHINE = "hailo15l_evb_defconfig"
```

## meta-hailo-bsp/conf/machine/hailo15l-oregano.conf
```bitbake
require include/hailo15l-base.inc
require include/hailo-vpu-base.inc

SCU_FW_MACHINE = "oregano"
SCU_BL_MACHINE = "oregano"
RECOVERY_FW_MACHINE = "oregano"

UBOOT_MACHINE = "hailo15l_oregano_defconfig"
```

## meta-hailo-bsp/conf/machine/hailo15l-sbc.conf
```bitbake
require include/hailo15l-base.inc
require include/hailo-vpu-base.inc

UBOOT_MACHINE = "hailo15l_sbc_defconfig"
```

## meta-hailo-bsp/conf/machine/hailo15l-veloce.conf
```bitbake
require include/hailo15l-base.inc
require include/veloce.inc

SCU_FW_MACHINE = "hailo15l_veloce"
SCU_BL_MACHINE = "hailo15l_veloce"
RECOVERY_FW_MACHINE = "hailo15l_veloce"

UBOOT_MACHINE = "hailo15l_veloce_defconfig"
```
